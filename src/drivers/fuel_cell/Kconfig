## src/drivers/fuel_cell/Kconfig
```kconfig
menuconfig DRIVERS_FUEL_CELL
 bool "fuel_cell"
 default n
 help
  Intelligent Energy fuel-cell telemetry over UART or CAN.
```

## src/modules/simulation/noctua_telemetry_sim/Kconfig
```kconfig
menuconfig MODULES_SIMULATION_NOCTUA_TELEMETRY_SIM
	bool "noctua_telemetry_sim"
	default n
	depends on PLATFORM_POSIX
	---help---
		SITL-only demo publisher for Noctua fuel-cell and H2-probe telemetry.
		Does not simulate hydrogen physics or change flight behavior.
```
