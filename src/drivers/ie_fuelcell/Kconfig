## src/drivers/ie_fuelcell/Kconfig
```kconfig
menuconfig DRIVERS_IE_FUELCELL
	bool "ie_fuelcell"
	default n
	---help---
		Enable support for IE FC
```

## src/drivers/sen0473/Kconfig
```kconfig
menuconfig DRIVERS_SEN0473
	bool "Gravity sen0473 H2 Sensor"
	default y
	---help---
		Enable support Gravity sen0473 Hydrogen sensor
```
