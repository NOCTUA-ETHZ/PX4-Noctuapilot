## src/drivers/gas_sensor/ze07_h2/Kconfig
```kconfig
menuconfig DRIVERS_GAS_SENSOR_ZE07_H2
	bool "Winsen ZE07-H2 hydrogen sensor (UART)"
	default n
	---help---
		Publish ZE07-H2 hydrogen measurements using sensor_gas_concentration.
```
